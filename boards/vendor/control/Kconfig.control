## boards/vendor/control/Kconfig.control
```kconfig
# Copyright (c) 2024 Nick Elsmore
# SPDX-License-Identifier: Apache-2.0

config BOARD_CONTROL
	select SOC_SAMD21J18A
```

## boards/vendor/control/board.yml
```yaml
# Copyright (c) 2024 Nick Elsmore
# SPDX-License-Identifier: Apache-2.0

board:
  name: control
  vendor: vendor
  socs:
    - name: samd21j18a
```

## boards/vendor/control/control_defconfig
```kconfig
# Copyright (c) 2024 Nick Elsmore
# SPDX-License-Identifier: Apache-2.0

CONFIG_SOC_ATMEL_SAMD_XOSC32K=y
CONFIG_SOC_ATMEL_SAMD_XOSC32K_AS_MAIN=y

CONFIG_BUILD_OUTPUT_HEX=y
```
